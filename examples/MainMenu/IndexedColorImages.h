typedef struct {
    uint8_t         width;
    uint8_t         height;
    const uint8_t   *colors;
    const uint8_t   *data;
} Indexed1BitImage;

typedef struct {
    uint8_t         width;
    uint8_t         height;
    const uint8_t   *colors;
    const uint8_t   *data;
} Indexed2BitImage;

void drawImage(int x, int y, const Indexed1BitImage *image) {
    if(x < 0 || y < 0 || x > pocketstar.xMax || y > pocketstar.yMax)
        return;
    
    uint8_t width = image->width;
    uint8_t height = image->height;
    uint32_t datalength = (((uint32_t) width) * height) / 8;
    const uint8_t *colors = image->colors;
    uint8_t cur;
    
    pocketstar.setX(x, x + width - 1);
    pocketstar.setY(y, y + height - 1);
    
    pocketstar.startTransfer();
    for (int i = 0; i < datalength; i++) {
        cur = image->data[i];
        for (int j = 7; j >= 0; j--) {
            uint8_t n = (cur >> j) & 0x01;
            pocketstar.writeBuffer(&colors[n], 1);
        }
    }
    
    uint8_t mod = (((uint8_t) width) * height) % 8;
    if (mod != 0) {
        cur = image->data[datalength];
        for (int j = mod; j >= 0; j--) {
            uint8_t n = (cur >> j) & 0x01;
            pocketstar.writeBuffer(&colors[n], 1);
        }
    }

    pocketstar.endTransfer();
}

void drawImage(int x, int y, const Indexed2BitImage *image) {
    if(x < 0 || y < 0 || x > pocketstar.xMax || y > pocketstar.yMax)
        return;
    
    uint8_t width = image->width;
    uint8_t height = image->height;
    uint32_t datalength = (((uint32_t) width) * height) / 4;
    const uint8_t *colors = image->colors;
    uint8_t cur;
    
    pocketstar.setX(x, x + width - 1);
    pocketstar.setY(y, y + height - 1);
    
    pocketstar.startTransfer();
    for (int i = 0; i < datalength; i++) {
        cur = image->data[i];
        for (int j = 6; j >= 0; j -= 2) {
            uint8_t n = (cur >> j) & 0x03;
            pocketstar.writeBuffer(&colors[n], 1);
        }
    }
    
    uint8_t mod = (((uint8_t) width) * height) % 4;
    if (mod != 0) {
        cur = image->data[datalength];
        for (int j = mod * 2; j >= 0; j -= 2) {
            uint8_t n = (cur >> j) & 0x03;
            pocketstar.writeBuffer(&colors[n], 1);
        }
    }

    pocketstar.endTransfer();
}

static const uint8_t PROGMEM menuGamesData[24*16/4] = {0x0, 0x15, 0x54, 0x0, 0x0, 0x0, 0x1, 0x55, 0x55, 0x40, 0x0, 0x0, 0x5,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 0x0, 0x0};
static const uint8_t PROGMEM menuGamesColors[4] = {BLACK_8b, YELLOW_8b, ORANGE_8b, BLACK_8b};
static Indexed2BitImage PROGMEM menuGamesImage = {24, 16, menuGamesColors, menuGamesData};

static const uint8_t PROGMEM menuAppsData[16*18/4] = {0x0, 0x1, 0x40, 0x0, 0x0, 0x16, 0x94, 0x0, 0x1, 0x68, 0x29, 0x40, 0x16,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 0x40, 0x0};
static const uint8_t PROGMEM menuAppsColors[4] = {BLACK_8b, GRAY_8b, WHITE_8b, BLACK_8b};
static Indexed2BitImage PROGMEM menuAppsImage = {16, 18, menuAppsColors, menuAppsData};

static const uint8_t PROGMEM menuSettingsData[16*16/8] = {0x1E, 0x0, 0xF, 0x0, 0x7, 0x80, 0x87, 0x80, 0xCF, 0x80, 0xFF, 0x80, 0xFF, 0xC0, 0x7F, 0xE0, 0x3F, 0xF0, 0x3, 0xF8, 0x1, 0xFC, 0x0, 0xFE, 0x0, 0x7F, 0x0, 0x3F, 0x0, 0x1F, 0x0, 0xE};
static const uint8_t PROGMEM menuSettingsColors[2] = {BLACK_8b, GRAY_8b};
static Indexed1BitImage PROGMEM menuSettingsImage = {16, 16, menuSettingsColors, menuSettingsData};

static const uint8_t PROGMEM menuInfoData[16*16/8] = {0x7, 0xE0, 0x18, 0x18, 0x21, 0x84, 0x43, 0xC2, 0x43, 0xC2, 0x81, 0x81, 0x80, 0x1, 0x83, 0xC1, 0x81, 0x81, 0x81, 0x81, 0x81, 0x81, 0x41, 0x82, 0x41, 0x82, 0x23, 0xC4, 0x18, 0x18, 0x7, 0xE0};
static const uint8_t PROGMEM menuInfoColors[2] = {BLACK_8b, BLUE_8b};
static Indexed1BitImage PROGMEM menuInfoImage = {16, 16, menuInfoColors, menuInfoData};
